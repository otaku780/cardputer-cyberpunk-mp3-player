#include "M5Cardputer.h"
#include <AudioOutput.h>
#include <AudioFileSourceSD.h>
#include <AudioGeneratorMP3.h>
#include "SD.h"
#include "SPI.h"
#include "esp_system.h"

SPIClass SDSPI(HSPI);

#define BLACKC 0x0000

struct Theme {
  uint16_t primary;
  uint16_t accent;
  const char* name;
};

Theme themes[] = {
  {0x07FF, 0xF81F, "CYAN/MAGENTA"},
  {0x07E0, 0x05A0, "GREEN MONO"},
  {0xF800, 0xFA8A, "RED ALERT"},
  {0xF8B2, 0xFB56, "PINK"},
  {0xFC60, 0xFE40, "ORANGE"},
  {0xFFE0, 0xFFF2, "YELLOW"}
};
const int numThemes = 6;
int themeIndex = 0;

uint16_t PRIMARY() { return themes[themeIndex].primary; }
uint16_t ACCENT() { return themes[themeIndex].accent; }

class AudioOutputM5Speaker : public AudioOutput {
 public:
  AudioOutputM5Speaker(m5::Speaker_Class* m5sound, uint8_t virtual_sound_channel = 0) {
    _m5sound = m5sound;
    _virtual_ch = virtual_sound_channel;
    for (int i = 0; i < 3; i++) {
      _tri_buffer[i] = (int16_t*)malloc(tri_buf_size * sizeof(int16_t));
    }
  }
  virtual ~AudioOutputM5Speaker(void) {
    for (int i = 0; i < 3; i++) if (_tri_buffer[i]) free(_tri_buffer[i]);
  }
  virtual bool begin(void) override { return true; }
  virtual bool ConsumeSample(int16_t sample[2]) override {
    if (_tri_buffer_index < tri_buf_size - 1) {
      _tri_buffer[_tri_index][_tri_buffer_index] = sample[0];
      _tri_buffer[_tri_index][_tri_buffer_index + 1] = sample[1];
      _tri_buffer_index += 2;
      return true;
    }
    flush();
    return false;
  }
  virtual void flush(void) {
    if (_tri_buffer_index) {
      _m5sound->playRaw(_tri_buffer[_tri_index], _tri_buffer_index, hertz, true, 1, _virtual_ch);
      _tri_index = _tri_index < 2 ? _tri_index + 1 : 0;
      _tri_buffer_index = 0;
    }
  }
  virtual bool SetRate(int hz) override { hertz = hz; return true; }

 protected:
  m5::Speaker_Class* _m5sound;
  uint8_t _virtual_ch;
  int hertz = 44100;
  int16_t* _tri_buffer[3] = {nullptr, nullptr, nullptr};
  size_t tri_buf_size = 1024;
  int _tri_index = 0;
  size_t _tri_buffer_index = 0;
};

AudioFileSourceSD* file = nullptr;
AudioGeneratorMP3* mp3 = nullptr;
AudioOutputM5Speaker* out;

String songs[50];
int songCount = 0;
int selected = 0;
int topOfList = 0;
bool isPlaying = false;
bool inPlayerScreen = false;
const int visibleRows = 6;

unsigned long songStartMillis = 0;
unsigned long pausedElapsed = 0;
int lastBatteryCheck = -1;
int cachedBattery = 0;
int screenW = 240;
int screenH = 135;

// Turn the display off after three minutes without keyboard activity.
const unsigned long SCREEN_TIMEOUT = 180000UL;
const uint8_t SCREEN_BRIGHTNESS = 128;
unsigned long lastActivityTime = 0;
bool screenIsOff = false;

int volume = 180;
unsigned long volMsgUntil = 0;

bool danceMode = false;
int dancePose = 0;
unsigned long lastDanceFrame = 0;
// Chippy dance mode only

const int numBars = 16;
int barHeights[numBars];
int barTargets[numBars];
// ---- Chippy dance sprite data (4 frames, 40x72, 4-bit indexed, palette per frame) ----
#define CHIPPY_W 40
#define CHIPPY_H 72
#define CHIPPY_FRAMES 4

const uint16_t chippyPalette1[16] PROGMEM = {
  0x0000, 0xFFFF, 0xFFFF, 0xFFFF, 0xF7FF, 0xFFDF, 0xFF9F, 0xFFBF, 0xEE3B, 0xC4F6, 0xAB94, 0x7311, 0x69EF, 0x692E, 0x396B, 0x2888,
};const uint8_t chippyFrame1[1440] PROGMEM = {
  0x00, 0x00, 0x00, 0x00, 0x00, 0x00, 0x00, 0x00, 0x00, 0x00, 0x00, 0x00, 0x00, 0x00, 0x00, 0x00,
  0x00, 0x00, 0x00, 0x00, 0x00, 0x00, 0x00, 0x00, 0x00, 0x00, 0x00, 0x00, 0x00, 0x00, 0x00, 0x00,
  0x00, 0x00, 0x00, 0x00, 0x00, 0x00, 0x00, 0x00, 0x00, 0x00, 0x00, 0x00, 0x00, 0x00, 0x00, 0x00,
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  0x00, 0x00, 0x00, 0x00, 0x00, 0x00, 0x00, 0x00, 0x00, 0x00, 0x00, 0x00, 0x00, 0x00, 0x00, 0x00,
};const uint16_t chippyPalette2[16] PROGMEM = {
  0x0000, 0xFFFF, 0xFFFF, 0xFFFF, 0xFFBF, 0xFFFF, 0xF7FF, 0xFFDF, 0xFF3F, 0xDD99, 0xB3F5, 0x7B32, 0x6A2F, 0x692E, 0x396B, 0x28A9,
};const uint8_t chippyFrame2[1440] PROGMEM = {
  0x00, 0x00, 0x00, 0x00, 0x00, 0x00, 0x00, 0x00, 0x00, 0x00, 0x00, 0x00, 0x00, 0x00, 0x00, 0x00,
  0x00, 0x00, 0x00, 0x00, 0x00, 0x00, 0x00, 0x00, 0x00, 0x00, 0x00, 0x00, 0x00, 0x00, 0x00, 0x00,
  0x00, 0x00, 0x00, 0x00, 0x00, 0x00, 0x00, 0x00, 0x00, 0x00, 0x00, 0x00, 0x00, 0x00, 0x00, 0x00,
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  0x00, 0x00, 0x00, 0x00, 0x00, 0x00, 0x00, 0x00, 0x00, 0x00, 0x00, 0x00, 0x08, 0x40, 0x00, 0x00,
};const uint16_t chippyPalette3[16] PROGMEM = {
  0x0000, 0xFFFF, 0xFFFF, 0xFFFF, 0xFFFF, 0xFFFF, 0xFFFF, 0xFFDF, 0xF73E, 0xE598, 0xBC15, 0x7B72, 0x722F, 0x692F, 0x396B, 0x30A8,
};const uint8_t chippyFrame3[1440] PROGMEM = {
  0x00, 0x00, 0x00, 0x00, 0x00, 0x00, 0x00, 0x00, 0x00, 0x00, 0x00, 0x00, 0x00, 0x00, 0x08, 0x00,
  0x00, 0x00, 0x00, 0x00, 0x00, 0x00, 0x00, 0x00, 0x00, 0x00, 0x00, 0x00, 0x00, 0x00, 0x00, 0x00,
  0x00, 0x00, 0x00, 0x00, 0x00, 0x8A, 0x90, 0x00, 0x00, 0x00, 0x00, 0x00, 0x00, 0x00, 0x00, 0x00,
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  0x00, 0x08, 0x08, 0x80, 0x00, 0x00, 0x00, 0x08, 0x98, 0x98, 0x80, 0x00, 0x00, 0x00, 0x00, 0x00,
};const uint16_t chippyPalette4[16] PROGMEM = {
  0x0000, 0xFFFF, 0xFFFF, 0xFFFF, 0xFFDF, 0xFFFF, 0xFFFF, 0xF7FF, 0xFFBF, 0xF71F, 0xDD78, 0xA3D4, 0x7A90, 0x716F, 0x398B, 0x3089,
};const uint8_t chippyFrame4[1440] PROGMEM = {
  0x00, 0x00, 0x00, 0x00, 0x00, 0x00, 0x00, 0x00, 0x00, 0x00, 0x00, 0x00, 0x00, 0x00, 0x00, 0x00,
  0x00, 0x00, 0x00, 0x00, 0x00, 0x00, 0x00, 0x00, 0x00, 0x00, 0x00, 0x00, 0x00, 0x00, 0x00, 0x00,
  0x00, 0x00, 0x00, 0x00, 0x00, 0x00, 0x00, 0x00, 0x00, 0x00, 0x00, 0x00, 0x00, 0x00, 0x00, 0x00,
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  0x00, 0x00, 0x00, 0x00, 0x00, 0x00, 0x00, 0x00, 0x00, 0x00, 0x00, 0x00, 0x08, 0x00, 0x00, 0x00,
};const uint8_t* chippyFrameData[CHIPPY_FRAMES] = { chippyFrame1, chippyFrame2, chippyFrame3, chippyFrame4 };
const uint16_t* chippyPaletteData[CHIPPY_FRAMES] = { chippyPalette1, chippyPalette2, chippyPalette3, chippyPalette4 };

void drawChippySprite(int frameIdx, int x, int y) {
  frameIdx = frameIdx % CHIPPY_FRAMES;
  const uint8_t* data = chippyFrameData[frameIdx];
  uint16_t pal[16];
  for (int i = 0; i < 16; i++) {
    pal[i] = pgm_read_word(&chippyPaletteData[frameIdx][i]);
  }

  int totalPixels = CHIPPY_W * CHIPPY_H;
  for (int row = 0; row < CHIPPY_H; row++) {
    int runStartCol = -1;
    uint16_t runColor = 0;
    for (int col = 0; col <= CHIPPY_W; col++) {
      uint8_t idx = 0;
      bool valid = (col < CHIPPY_W);
      if (valid) {
        int pixelNum = row * CHIPPY_W + col;
        uint8_t byteVal = pgm_read_byte(&data[pixelNum / 2]);
        idx = (pixelNum % 2 == 0) ? (byteVal >> 4) : (byteVal & 0x0F);
      }
      bool isTransparent = (!valid) || (idx == 0);
      if (!isTransparent) {
        uint16_t color = pal[idx];
        if (runStartCol == -1) {
          runStartCol = col;
          runColor = color;
        } else if (color != runColor) {
          M5Cardputer.Display.drawFastHLine(x + runStartCol, y + row, col - runStartCol, runColor);
          runStartCol = col;
          runColor = color;
        }
      } else {
        if (runStartCol != -1) {
          M5Cardputer.Display.drawFastHLine(x + runStartCol, y + row, col - runStartCol, runColor);
          runStartCol = -1;
        }
      }
    }
  }
}void drawBorder() {
  M5Cardputer.Display.drawRect(0, 0, screenW, screenH, PRIMARY());
  M5Cardputer.Display.drawRect(1, 1, screenW - 2, screenH - 2, PRIMARY());
}

void drawBattery() {
  unsigned long now = millis();
  if (lastBatteryCheck < 0 || now - (unsigned long)lastBatteryCheck > 2000) {
    cachedBattery = M5Cardputer.Power.getBatteryLevel();
    lastBatteryCheck = now;
  }
  M5Cardputer.Display.setTextColor(PRIMARY(), BLACKC);
  String batStr = String(cachedBattery) + "%";
  int x = screenW - 6 - (batStr.length() * 6);
  M5Cardputer.Display.drawString(batStr, x, 5);
}

void drawList() {
  danceMode = false;
  M5Cardputer.Display.fillScreen(BLACKC);
  drawBorder();
  M5Cardputer.Display.setTextSize(1);
  M5Cardputer.Display.setTextColor(ACCENT(), BLACKC);
  M5Cardputer.Display.drawString("MP3 PLAYER // v4", 6, 5);
  drawBattery();
  M5Cardputer.Display.drawFastHLine(4, 16, screenW - 8, PRIMARY());

  if (songCount == 0) {
    M5Cardputer.Display.setTextColor(PRIMARY(), BLACKC);
    M5Cardputer.Display.drawString("No MP3 files found", 6, 26);
  } else {
    for (int i = 0; i < visibleRows; i++) {
      int idx = topOfList + i;
      if (idx >= songCount) break;
      int y = 20 + i * 14;
      if (idx == selected) {
        M5Cardputer.Display.fillRect(4, y - 1, screenW - 8, 13, PRIMARY());
        M5Cardputer.Display.setTextColor(BLACKC, PRIMARY());
      } else {
        M5Cardputer.Display.setTextColor(PRIMARY(), BLACKC);
      }
      String name = songs[idx];
      if (name.length() > 32) name = name.substring(0, 32);
      M5Cardputer.Display.drawString(name, 8, y);
    }
  }

  M5Cardputer.Display.drawFastHLine(4, screenH - 16, screenW - 8, PRIMARY());
  M5Cardputer.Display.setTextColor(ACCENT(), BLACKC);
  M5Cardputer.Display.drawString(";/.=move ENTER=play L=theme", 6, screenH - 12);
}

String formatTime(unsigned long ms) {
  unsigned long totalSec = ms / 1000;
  unsigned long mins = totalSec / 60;
  unsigned long secs = totalSec % 60;
  String o = String(mins) + ":";
  if (secs < 10) o += "0";
  o += String(secs);
  return o;
}

int barAreaX, barAreaY, barAreaW, barAreaH;

void drawPlayerScreen(String status) {
  danceMode = false;
  M5Cardputer.Display.fillScreen(BLACKC);
  drawBorder();
  M5Cardputer.Display.setTextSize(1);
  M5Cardputer.Display.setTextColor(ACCENT(), BLACKC);
  M5Cardputer.Display.drawString("NOW PLAYING", 6, 5);
  drawBattery();
  M5Cardputer.Display.drawFastHLine(4, 16, screenW - 8, PRIMARY());

  String name = songs[selected];
  if (name.length() > 32) name = name.substring(0, 32);
  M5Cardputer.Display.setTextColor(ACCENT(), BLACKC);
  M5Cardputer.Display.drawString(name, 8, 22);

  M5Cardputer.Display.setTextColor(PRIMARY(), BLACKC);
  M5Cardputer.Display.drawString(status, 8, 36);

  barAreaX = 8;
  barAreaY = 50;
  barAreaW = screenW - 16;
  barAreaH = 36;
  M5Cardputer.Display.drawRect(barAreaX - 2, barAreaY - 2, barAreaW + 4, barAreaH + 4, PRIMARY());

  for (int i = 0; i < numBars; i++) {
    barHeights[i] = 2;
    barTargets[i] = 2;
  }

  M5Cardputer.Display.drawFastHLine(4, screenH - 30, screenW - 8, PRIMARY());
  M5Cardputer.Display.setTextColor(ACCENT(), BLACKC);
  M5Cardputer.Display.drawString("P N B Q L G V  S:dance", 6, screenH - 26);
  M5Cardputer.Display.drawFastHLine(4, screenH - 16, screenW - 8, PRIMARY());
}

void updatePlayerTime() {
  if (!inPlayerScreen || danceMode) return;
  if (millis() < volMsgUntil) return;
  unsigned long elapsed = isPlaying ? (millis() - songStartMillis + pausedElapsed) : pausedElapsed;
  M5Cardputer.Display.fillRect(90, 36, 90, 12, BLACKC);
  M5Cardputer.Display.setTextColor(PRIMARY(), BLACKC);
  M5Cardputer.Display.drawString(formatTime(elapsed), 90, 36);
}

void showVolume() {
  if (danceMode) return;
  int pct = (volume * 100) / 255;
  M5Cardputer.Display.fillRect(90, 36, 90, 12, BLACKC);
  M5Cardputer.Display.setTextColor(ACCENT(), BLACKC);
  M5Cardputer.Display.drawString("Vol:" + String(pct) + "%", 90, 36);
  volMsgUntil = millis() + 1200;
}

void changeVolume(int delta) {
  volume += delta;
  if (volume < 0) volume = 0;
  if (volume > 255) volume = 255;
  M5Cardputer.Speaker.setVolume(volume);
  if (inPlayerScreen) showVolume();
}

void updateVisualizer() {
  if (!inPlayerScreen || danceMode) return;
  int barW = barAreaW / numBars;
  for (int i = 0; i < numBars; i++) {
    if (isPlaying) {
      if (random(0, 100) < 40) {
        barTargets[i] = random(2, barAreaH);
      }
      if (barHeights[i] < barTargets[i]) {
        barHeights[i] += 4;
        if (barHeights[i] > barTargets[i]) barHeights[i] = barTargets[i];
      } else if (barHeights[i] > barTargets[i]) {
        barHeights[i] -= 2;
        if (barHeights[i] < barTargets[i]) barHeights[i] = barTargets[i];
      }
    } else {
      barTargets[i] = 2;
      if (barHeights[i] > 2) barHeights[i] -= 2;
    }

    int x = barAreaX + i * barW;
    M5Cardputer.Display.fillRect(x, barAreaY, barW - 1, barAreaH, BLACKC);
    int h = barHeights[i];
    M5Cardputer.Display.fillRect(x, barAreaY + (barAreaH - h), barW - 1, h, ACCENT());
  }
}

void danceHeaderText() {
  M5Cardputer.Display.fillRect(4, 4, screenW - 8, 10, BLACKC);
  M5Cardputer.Display.setTextColor(ACCENT(), BLACKC);
  M5Cardputer.Display.drawString("CHIPPY DANCE MODE - any key exits", 6, 5);
}

void enterDanceMode() {
  danceMode = true;
  dancePose = 0;
  lastDanceFrame = 0;
  M5Cardputer.Display.fillScreen(BLACKC);
  drawBorder();
  danceHeaderText();
}

void thickLine(int x0, int y0, int x1, int y1, uint16_t color, int thickness) {
  float dx = x1 - x0;
  float dy = y1 - y0;
  float len = sqrt(dx * dx + dy * dy);
  if (len < 0.001) len = 0.001;
  float nx = -dy / len * (thickness / 2.0);
  float ny = dx / len * (thickness / 2.0);
  M5Cardputer.Display.fillTriangle(x0 + nx, y0 + ny, x0 - nx, y0 - ny, x1 + nx, y1 + ny, color);
  M5Cardputer.Display.fillTriangle(x1 + nx, y1 + ny, x1 - nx, y1 - ny, x0 - nx, y0 - ny, color);
}

void drawChippy() {
  M5Cardputer.Display.fillRect(4, 18, screenW - 8, screenH - 40, BLACKC);
  int frameIdx = dancePose % CHIPPY_FRAMES;
  int x = (screenW - CHIPPY_W) / 2;
  int y = screenH - 18 - CHIPPY_H;
  if (y < 18) y = 18;
  drawChippySprite(frameIdx, x, y);
}

void drawDancer() {
  drawChippy();
}

void cycleTheme() {
  themeIndex = (themeIndex + 1) % numThemes;
  if (danceMode) {
    enterDanceMode();
  } else if (inPlayerScreen) {
    drawPlayerScreen(isPlaying ? "Playing..." : "Paused");
  } else {
    drawList();
  }
}

void scanSongs() {
  songCount = 0;
  File root = SD.open("/");
  File entry = root.openNextFile();
  while (entry && songCount < 50) {
    String name = String(entry.name());
    if (!entry.isDirectory() && name.endsWith(".mp3")) {
      songs[songCount] = name;
      songCount++;
    }
    entry = root.openNextFile();
  }
}

void startSong(int idx) {
  if (mp3) {
    if (mp3->isRunning()) mp3->stop();
    delete mp3;
    mp3 = nullptr;
  }
  if (file) { delete file; file = nullptr; }

  String path = "/" + songs[idx];
  file = new AudioFileSourceSD(path.c_str());
  mp3 = new AudioGeneratorMP3();
  bool ok = mp3->begin(file, out);
  Serial.printf("mp3 begin result: %d for %s\n", ok, path.c_str());
  isPlaying = true;
  inPlayerScreen = true;
  songStartMillis = millis();
  pausedElapsed = 0;
  volMsgUntil = 0;
  drawPlayerScreen("Playing...");
}

void playNextAuto() {
  selected++;
  if (selected >= songCount) selected = 0;
  startSong(selected);
}

void setup() {
  Serial.begin(115200);
  delay(1000);
  Serial.println("Booting player...");

  esp_reset_reason_t reason = esp_reset_reason();
  Serial.printf("Reset reason code: %d\n", (int)reason);

  auto cfg = M5.config();
  M5Cardputer.begin(cfg, true);
  M5Cardputer.Speaker.begin();
  M5Cardputer.Speaker.setVolume(volume);
  M5Cardputer.Display.setRotation(1);
  M5Cardputer.Display.setBrightness(SCREEN_BRIGHTNESS);
  lastActivityTime = millis();
  screenIsOff = false;

  screenW = M5Cardputer.Display.width();
  screenH = M5Cardputer.Display.height();

  randomSeed(analogRead(0));

  SDSPI.begin(40, 39, 14, 12);
  bool sdok = SD.begin(12, SDSPI, 25000000);
  Serial.printf("SD begin: %d\n", sdok);

  out = new AudioOutputM5Speaker(&M5Cardputer.Speaker, 0);

  scanSongs();
  Serial.printf("Found %d songs\n", songCount);
  drawList();
}

unsigned long lastTimeUpdate = 0;
unsigned long lastVisUpdate = 0;

void loop() {
  M5Cardputer.update();

  if (isPlaying && mp3 && mp3->isRunning()) {
    bool ok = mp3->loop();
    if (!ok) {
      mp3->stop();
      if (songCount > 0) {
        playNextAuto();
      } else {
        isPlaying = false;
        if (inPlayerScreen && !danceMode) drawPlayerScreen("Finished");
      }
    }
  }

  if (inPlayerScreen && !danceMode && millis() - lastTimeUpdate > 500) {
    updatePlayerTime();
    lastTimeUpdate = millis();
  }

  if (inPlayerScreen && !danceMode && millis() - lastVisUpdate > 80) {
    updateVisualizer();
    lastVisUpdate = millis();
  }

  if (danceMode && millis() - lastDanceFrame > 180) {
    dancePose++;
    drawDancer();
    lastDanceFrame = millis();
  }

  if (M5Cardputer.Keyboard.isChange() && M5Cardputer.Keyboard.isPressed()) {
    lastActivityTime = millis();

    if (screenIsOff) {
      M5Cardputer.Display.setBrightness(SCREEN_BRIGHTNESS);
      screenIsOff = false;

      if (danceMode) {
        enterDanceMode();
        drawDancer();
      } else if (inPlayerScreen) {
        drawPlayerScreen(isPlaying ? "Playing..." : "Paused");
      } else {
        drawList();
      }
      return;  // The key used to wake the screen does not trigger an action.
    }

    Keyboard_Class::KeysState ks = M5Cardputer.Keyboard.keysState();

    bool themeKeyHit = false;
    bool volUpHit = false;
    bool volDownHit = false;
    bool danceKeyHit = false;
    for (auto c : ks.word) {
      if (c == 'l' || c == 'L') themeKeyHit = true;
      if (c == 'g' || c == 'G') volUpHit = true;
      if (c == 'v' || c == 'V') volDownHit = true;
      if (c == 's' || c == 'S') danceKeyHit = true;
    }

    if (danceMode) {
      danceMode = false;
      drawPlayerScreen(isPlaying ? "Playing..." : "Paused");
      return;
    }

    if (themeKeyHit) {
      cycleTheme();
    } else if (volUpHit) {
      changeVolume(25);
    } else if (volDownHit) {
      changeVolume(-25);
    } else if (danceKeyHit && inPlayerScreen) {
      enterDanceMode();
    } else if (!inPlayerScreen) {
      for (auto c : ks.word) {
        if (c == ';') {
          if (selected > 0) selected--;
          if (selected < topOfList) topOfList = selected;
          drawList();
        } else if (c == '.') {
          if (selected < songCount - 1) selected++;
          if (selected >= topOfList + visibleRows) topOfList = selected - visibleRows + 1;
          drawList();
        }
      }
      if (ks.enter) {
        if (songCount > 0) startSong(selected);
      }
    } else {
      for (auto c : ks.word) {
        if (c == 'p' || c == 'P') {
          if (isPlaying) {
            isPlaying = false;
            pausedElapsed += millis() - songStartMillis;
            drawPlayerScreen("Paused");
          } else {
            isPlaying = true;
            songStartMillis = millis();
            drawPlayerScreen("Playing...");
          }
        } else if (c == 'n' || c == 'N') {
          if (selected < songCount - 1) {
            selected++;
          } else {
            selected = 0;
          }
          startSong(selected);
        } else if (c == 'b' || c == 'B') {
          if (selected > 0) {
            selected--;
          } else {
            selected = songCount - 1;
          }
          startSong(selected);
        } else if (c == 'q' || c == 'Q') {
          if (mp3 && mp3->isRunning()) mp3->stop();
          isPlaying = false;
          inPlayerScreen = false;
          drawList();
        }
      }
    }
  }

  if (!screenIsOff && millis() - lastActivityTime >= SCREEN_TIMEOUT) {
    M5Cardputer.Display.setBrightness(0);
    screenIsOff = true;
  }
}
